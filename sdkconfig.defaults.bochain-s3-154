## sdkconfig.defaults.bochain-s3-154
```kconfig
# BoChain ESP32-S3 1.54 ST7789 240x240
# Board: main/boards/bread-compact-wifi-lcd

# Select the LCD board, not the non-screen WiFi board.
# CONFIG_BOARD_TYPE_BREAD_COMPACT_WIFI is not set
CONFIG_BOARD_TYPE_BREAD_COMPACT_WIFI_LCD=y
# CONFIG_BOARD_TYPE_BREAD_COMPACT_WIFI_CAM is not set
# CONFIG_BOARD_TYPE_BREAD_COMPACT_ML307 is not set
# CONFIG_BOARD_TYPE_BREAD_COMPACT_NT26 is not set

CONFIG_IDF_TARGET="esp32s3"

CONFIG_ESPTOOLPY_FLASHSIZE_16MB=y
CONFIG_ESPTOOLPY_FLASHMODE_DIO=y
CONFIG_ESPTOOLPY_FLASHFREQ_80M=y

CONFIG_SPIRAM=y
CONFIG_SPIRAM_MODE_OCT=y
CONFIG_SPIRAM_SPEED_80M=y
```
